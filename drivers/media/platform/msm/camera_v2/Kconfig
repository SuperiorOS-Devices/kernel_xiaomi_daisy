## drivers/media/platform/msm/camera_v2/Kconfig
```kconfig
config MSM_CAMERA_SENSOR
	    bool "QTI MSM camera sensor support"
	    depends on MSMB_CAMERA
	    select NEW_LEDS
	    select LEDS_CLASS
        ---help---
          This flag enables support for Camera Sensor.
          The sensor driver is capable of providing real time
          data for camera support. The driver support V4L2
          subdev APIs.

config MSM_CPP
        bool "QTI MSM Camera Post Processing Engine support"
        depends on MSMB_CAMERA
        ---help---
          Enable support for Camera Post-processing Engine
          The Post processing engine is capable of scaling
          and cropping image. The driver support V4L2 subdev
          APIs.

config MSM_CCI
        bool "QTI MSM Camera Control Interface support"
        depends on MSMB_CAMERA
        ---help---
          Enable support for Camera Control Interface driver only
          for those platforms that have hardware support. This driver
          is responsible for handling I2C read and write on the I2C
          bus. It is also responsible for synchronization with
          GPIO and data frames.

config MSM_CSI20_HEADER
        bool "QTI MSM CSI 2.0 Header"
        depends on MSMB_CAMERA
        ---help---
          Enable support for CSI drivers to include 2.0
          header. This header has register macros and its
          values and bit mask for register configuration bits
          This config macro is required targets based on 8960,
          8930 and 8064 platforms.

config MSM_CSI22_HEADER
        bool "QTI MSM CSI 2.2 Header"
        depends on MSMB_CAMERA
        ---help---
          Enable support for CSI drivers to include 2.2
          header. This header has register macros and its
          values and bit mask for register configuration bits
          This config macro is required targets based on 8610
          platform.

config MSM_CSI30_HEADER
        bool "QTI MSM CSI 3.0 Header"
        depends on MSMB_CAMERA
        ---help---
          Enable support for CSI drivers to include 3.0
          header. This header has register macros and its
          values and bit mask for register configuration bits
          This config macro is required for targets based on
          8064 platforms.

config MSM_CSI31_HEADER
        bool "QTI MSM CSI 3.1 Header"
        depends on MSMB_CAMERA
        ---help---
          Enable support for CSI drivers to include 3.0
          header. This header has register macros and its
          values and bit mask for register configuration bits
          This config macro is required for targets based on
          APQ8084 platform.

config MSM_CSIPHY
        bool "QTI MSM Camera Serial Interface Physical receiver support"
        depends on MSMB_CAMERA
        ---help---
          Enable support for Camera Serial Interface
          Physical receiver. It deserializes packets and
          supports detection of packet start and stop
          signalling.

config MSM_CSID
        bool "QTI MSM Camera Serial Interface decoder support"
        depends on MSMB_CAMERA
        ---help---
          Enable support for Camera Serial Interface decoder.
          It supports lane merging and decoding of packets
          based on cid which is mapped to a virtual channel
          and datatype.

config MSM_EEPROM
        bool "QTI MSM Camera ROM Interface for Calibration support"
        depends on MSMB_CAMERA
        ---help---
          Enable support for ROM Interface for Calibration
          Provides interface for reading the Claibration data.
          and also provides support for writing data in case of FLASH ROM.
	  Currently supports I2C, CCI and SPI protocol

config MSM_ISP_V1
        bool "QTI MSM Image Signal Processing interface support"
        depends on MSMB_CAMERA
        ---help---
          Enable support for Image Signal Processing interface module.
          This module acts as a crossbar between CSID and VFE. Output
          of any CID of CSID can be routed to of pix or raw
          data interface in VFE.

config MSM_ISPIF
        bool "QTI MSM Image Signal Processing interface support"
        depends on MSMB_CAMERA
        ---help---
          Enable support for Image Signal Processing interface module.
          This module acts as a crossbar between CSID and VFE. Output
          of any CID of CSID can be routed to of pix or raw
          data interface in VFE.

config MSM_ISPIF_V1
        bool "QTI MSM Image Signal Processing interface support"
        depends on MSMB_CAMERA
        ---help---
          Enable support for Image Signal Processing interface module.
          This module acts as a crossbar between CSID and VFE. Output
          of any CID of MSM_CSI22_HEADER can be routed to of pix
          or raw data interface in VFE.

config MSM_ISPIF_V2
        bool "QTI MSM Image Signal Processing interface support"
        depends on MSMB_CAMERA
        ---help---
          Enable support for Image Signal Processing interface module.
          This module acts as a crossbar between CSID and VFE. Output
          of any CID of CSID can be routed to of pix
          or raw data interface in VFE.
          
config MSM_V4L2_VIDEO_OVERLAY_DEVICE
	tristate "QTI MSM V4l2 video overlay device"
	---help---
	  Enables support for the MSM V4L2 video
	  overlay driver. This allows video rendering
	  apps to render overlaid video using Video4Linux2
	  APIs, by using /dev/videoX device

config MSMB_JPEG
	tristate "QTI MSM Jpeg Encoder Engine support"
        depends on MSMB_CAMERA && (ARCH_MSM8974 || ARCH_MSM8226 || ARCH_APQ8084 || ARCH_MSM8916 || ARCH_QCOM)
	---help---
	  Enable support for Jpeg Encoder/Decoder
	  Engine for 8974.
	  This module serves as the common driver
	  for the JPEG 1.0 encoder and decoder.

config MSM_GEMINI
	tristate "QTI MSM Gemini JPEG engine support"
	depends on MSMB_CAMERA && (ARCH_MSM7X30 || ARCH_MSM8X60 || ARCH_MSM8960)
	---help---
	  Enables support for the Gemini JPEG encoder
	  Engine for 8x60, 7x30 and 8960.
	  This module serves as the driver
	  for JPEG encoding functionality.

config MSM_FD
	 tristate "QTI MSM FD face detection engine support"
	 depends on MSMB_CAMERA
	 ---help---
	    Enables support for the MSM FD face detection engine
            Engine for 8996, 8998.
            This module serves as the driver for
            detection of face ROI in a luma frame.

config MSM_JPEGDMA
	tristate "QTI MSM Jpeg dma"
        depends on MSMB_CAMERA
        select V4L2_MEM2MEM_DEV
	---help---
	  Enable support for Jpeg dma engine
          Engine for 8996, 8998.
          This module serves as the driver for
          downscale and data transfer functionality.

config MSM_SEC_CCI_TA_NAME
	string "Name of TA to handle Secure CCI transactions"
	depends on MSM_CCI
	default "seccamdemo64"

config MSM_SEC_CCI_DEBUG
	bool "QTI MSM Secure CCI Relay Debug"
	depends on MSM_CCI
	---help---
	  Enables simulation of secure camera for Secure CCI Realy
	  debugging.
```
